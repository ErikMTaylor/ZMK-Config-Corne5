## config/west.yml
```yaml
manifest:
  remotes:
    - name: zmkfirmware
      url-base: https://github.com/zmkfirmware
    - name: ErikMTaylor
      url-base: https://github.com/ErikMTaylor
  projects:
    - name: zmk
      remote: zmkfirmware
      revision: main
      import: app/west.yml
    - name: nice-view-glitch-rick
      remote: ErikMTaylor
      revision: main
  self:
    path: config
```
